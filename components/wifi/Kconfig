## components/wifi/Kconfig
```kconfig
menu ""
config LOSCFG_COMPONENTS_NET_AT_DEBUG
    bool "Enable AT DEBUG"
    default n

config LOSCFG_COMPONENTS_NET_AT_SOCKET
    bool "Enable AT SOCKET API"
    default n

# 手动输入WIFI SSID
config LOSCFG_COMPONENTS_NET_AT_DEFAULT_WIFI_SSID
    string "Default WIFI CONNECT SSID"
    default ""
    help
      Enter a custom string for wifi ssid.


# 手动输入WIFI password
config LOSCFG_COMPONENTS_NET_AT_DEFAULT_WIFI_PASSWORD
    string "Default WIFI CONNECT Password"
    default ""
    help
      Enter a custom string for wifi password.

# 手动输入AP 默认IP地址
config LOSCFG_COMPONENTS_NET_AT_DEFAULT_WIFI_AP_IP
    string "Default WIFI AP IP"
    default "192.168.1.1"
    help
      Enter a custom string for wifi AP mode ip address.

# 手动输入AP 默认DHCP地址
config LOSCFG_COMPONENTS_NET_AT_DEFAULT_WIFI_AP_DHCP_IP_MIN
    string "Default WIFI AP DHCP IP MIN"
    default "192.168.1.2"
    help
      Enter a custom string for wifi DHCP min ip address.


config LOSCFG_COMPONENTS_NET_AT_DEFAULT_WIFI_AP_DHCP_IP_MAX
    string "Default WIFI AP DHCP IP MAX"
    default "192.168.1.254"
    help
      Enter a custom string for wifi DHCP max ip address.

# 选择WIFI模块型号
choice
    prompt "Choose AT Device"
    default LOSCFG_COMPONENTS_NET_AT_ESP8266

    config LOSCFG_COMPONENTS_NET_AT_ESP8266
    bool "Enable esp8266"
endchoice


# 特定客户选项
choice
    prompt "Choose Customer"
    depends on LOSCFG_COMPONENTS_NET_AT_ESP8266
    default LOSCFG_COMPONENTS_NET_AT_ESP8266_HZR_SPK

    config LOSCFG_COMPONENTS_NET_AT_ESP8266_HZR_SPK
    bool "Enable HZR SPK CONFIG"
    depends on LOSCFG_COMPONENTS_NET_AT_ESP8266

endchoice

endmenu
```
